## drivers/misc/mediatek/connectivity/bt/linux_v2/Kconfig
```kconfig
# SPDX-License-Identifier: GPL-2.0-only

config MTK_BTMTK_SDIO_UNIFY
	tristate "MediaTek linux_v2 Bluetooth driver for SDIO combo chips"
	depends on MMC && BT && m
	help
	  MediaTek linux_v2 Bluetooth driver for the MT7902 SDIO chip.

config MTK_BTMTK_SDIO_UNIFY_DEBUG
	bool "linux_v2 Bluetooth debug features"
	depends on MTK_BTMTK_SDIO_UNIFY
	help
	  Enable the debug features of MediaTek's non-user builds.
```

## drivers/misc/mediatek/connectivity/wlan/gen4-mt79xx/Kconfig
```kconfig
# SPDX-License-Identifier: GPL-2.0-only

config MTK_WLAN_GEN4_MT79XX
	tristate "MediaTek MT7902 SDIO Wi-Fi driver"
	depends on CFG80211 && MMC && m
	help
	  MediaTek gen4-mt79xx Wi-Fi driver for the MT7902 SDIO chip.

if MTK_WLAN_GEN4_MT79XX

config MTK_WLAN_GEN4_MT79XX_PREALLOC
	bool "Preallocated buffer module"
	default y
	help
	  Build wlan_mt7902_sdio_prealloc.ko.

config MTK_WLAN_GEN4_MT79XX_RESET
	bool "Chip reset and power control module"
	default y
	select MMC_EXPOSE_START_HOST_API
	help
	  Build wlan_mt7902_sdio_reset.ko.

endif # MTK_WLAN_GEN4_MT79XX
```

## drivers/misc/mediatek/connectivity/wlan/gen4-mt79xx/configs/MT7926/alps/defconfig
```kconfig
CONFIG_MTK_CONNSYS_DEDICATED_LOG_PATH=n
CONFIG_SUPPORT_DFS_OFFLOAD=n
CONFIG_SUPPORT_FW_IDX_LOG_TRANS=n
CONFIG_SUPPORT_HE_ER=y
CONFIG_SUPPORT_APFV6=y

ifeq ($(CONFIG_MTK_COMBO_WIFI_HIF), sdio)
CONFIG_CHIP_RESET_KO_SUPPORT=y
ccflags-y += -DCFG_SDIO_INTR_ENHANCE_FORMAT=2
ccflags-y += -DCFG_CHIP_RESET_USE_MSTAR_GPIO_API=0
#for CpuBoost, config platform
ifeq ($(CONFIG_MTK_COMBO_CHIP_CONSYS_8171), y)
    MTK_PLATFORM := mt8171
endif
endif

ifeq ($(CONFIG_GKI_SUPPORT), y)
ccflags-y += -DCFG_DC_USB_WOW_CALLBACK=0
endif

ifeq ($(CONFIG_DRM_MEDIATEK_V2), y)
ccflags-$(CONFIG_DRM_MEDIATEK_V2) += -I$(srctree)/drivers/gpu/drm/mediatek/mediatek_v2/
endif

ccflags-y += $(call cc-disable-warning, unused-but-set-variable)
PLATFORM_FLAGS += $(call cc-disable-warning, unused-but-set-variable)
ccflags-y += $(call cc-disable-warning, unused-function)
PLATFORM_FLAGS += $(call cc-disable-warning, unused-function)
ccflags-y += -DCFG_DEFAULT_DBG_LEVEL=0xF

ccflags-y += -DCFG_WIFI_CFG_FN='"wifi_mt7926.cfg"'
```

## drivers/misc/mediatek/connectivity/wlan/gen4-mt79xx/configs/MT7961/dev_features/defconfig
```kconfig
$(info dev config)
CONFIG_CONNAC2_LISTMODE_ENABLE=n
# For SQC only
CONFIG_SUPPORT_SER_DEBUGFS=y
# For Auto only
CONFIG_CONNAC2_PROTECT_SEC_FWDL=y
# For Pwr table compatibility
CONFIG_MTK_WIFI_TXPWR_DAT_FN=y
# For SQC2.7
CONFIG_MTK_WIFI_SUPPORT_6G_PWR_REGS=y
CONFIG_SUPPORT_FW_LOG_TIMESYNC=y
CONFIG_PCIE_FW_OWN_BYPASS=y
ifeq ($(CONFIG_MTK_COMBO_WIFI_HIF), pcie)
CONFIG_SUPPORT_RX_NAPI=y
endif

#0: no mem shrink 1: low mem shrink 2: middle mem shrink 3: high mem shrink
#SQC2.7 use level 1
CONFIG_MEM_SHRINK_LEVEL=1

# NAN Advanced SQC
CONFIG_MTK_WIFI_NAN_SUPPORT_R4=y
CONFIG_MTK_WIFI_NAN_P2P_CONCURRENT_SUPPORT=y
```

## drivers/misc/mediatek/connectivity/wlan/gen4-mt79xx/configs/defconfig
```kconfig
CONFIG_SUPPORT_DEBUG_FS=n
CONFIG_SUPPORT_PROC_FS=y
CONFIG_SUPPORT_AGPS_ASSIST=n
CONFIG_SUPPORT_TSF_USING_BOOTTIME=y
CONFIG_ARP_MONITER_ENABLE=y
CONFIG_DRIVER_INITIAL_RUNNING_MODE=3

ifneq ($(filter v-% 16-%, $(MTK_ANDROID_VERSION)),)
CONFIG_KERNEL_AN15_OR_LATER = 1
endif
```
