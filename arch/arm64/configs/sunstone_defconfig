## arch/arm64/configs/sunstone_defconfig
```kconfig
CONFIG_BUILD_CONFIG_FILE="build.config.mtk.aarch64"
CONFIG_ARCH_MEDIATEK=y
CONFIG_ARM_DSU_PMU=m
CONFIG_PM_DEBUG=y
CONFIG_MTK_CLKBUF=m
CONFIG_MTK_CLKBUF_V1=y
CONFIG_MTK_SRCLKEN_RC_V1=y
CONFIG_MTK_DVFSRC_HELPER=m
CONFIG_MTK_DVFSRC_MET_MT6873=m
CONFIG_THERMAL_EMERGENCY_POWEROFF_DELAY_MS=100
CONFIG_THERMAL_WRITABLE_TRIPS=y
CONFIG_THERMAL_DEFAULT_GOV_POWER_ALLOCATOR=y
CONFIG_THERMAL_EMULATION=y
CONFIG_DMABUF_HEAPS_MTK_MM=m
CONFIG_DMABUF_HEAPS_MTK_SVP=m
CONFIG_DMABUF_HEAPS_SYSTEM=m
CONFIG_DMABUF_HEAPS_DEBUG=m
CONFIG_MTK_BATTERY_OC_POWER_THROTTLING=y
CONFIG_MTK_LOW_BATTERY_POWER_THROTTLING=y
CONFIG_MTK_IOMMU_MISC=m
CONFIG_MTK_IOMMU_MISC_SECURE=m
CONFIG_MTK_CMDQ_MBOX_EXT=m
CONFIG_MTK_MDP=m
CONFIG_MTK_MDP_MT8188=m
CONFIG_MMPROFILE=m
CONFIG_WFD_DYNAMIC_SEC_BUF=y
CONFIG_SVP_DYNAMIC_SEC_BUF=y
CONFIG_TEE=m
CONFIG_OPTEE=m
CONFIG_MTK_TEE_GP_SUPPORT=m
CONFIG_GOODIX_FINGERPRINT=m
CONFIG_DEFAULT_HUNG_TASK_TIMEOUT=0
CONFIG_MTK_TRUSTED_MEMORY_SUBSYSTEM=m
CONFIG_MTK_APUSYS_DEBUG=y
CONFIG_MTK_APUSYS_MDLA_SUPPORT=y
CONFIG_MTK_APUSYS_SUPPORT=m
CONFIG_MTK_APUSYS_VPU=y
CONFIG_MTK_AEE_FEATURE=m
CONFIG_MTK_AEE_AED=m
CONFIG_MTK_AEE_HANGDET=m
CONFIG_MTK_AEE_IPANIC=m
# CONFIG_MTK_AEE_HWT_BACKTO_KERNEL is not set
CONFIG_MTK_DRAM_LOG_STORE=m
CONFIG_MTK_DRAM_LOG_STORE_ADDR=0x0011DF00
CONFIG_MTK_DRAM_LOG_STORE_SIZE=0x100
CONFIG_MTPROF=m
CONFIG_MTK_DHCPV6C_WIFI=y
# CONFIG_MTK_CONN_LTE_IDC_SUPPORT is not set
CONFIG_MTK_GPS_EMI=m
CONFIG_MTK_FMRADIO=m
CONFIG_MTK_FM_CHIP="MT6635_FM"
CONFIG_RT_REGMAP=m
CONFIG_TCPC_CLASS=m
CONFIG_MTK_BUS_TRACER=m
CONFIG_MTK_DEBUG_TRACER=m
CONFIG_TCPC_RT1711H=m
CONFIG_TCPC_HUSB311=m
CONFIG_EXTCON_MTK_USB=m
CONFIG_MTK_USB_TYPEC_MUX=m
CONFIG_WAS4780_AUDIO_SWITCH=m
CONFIG_SCSI_UFS_MEDIATEK=m
CONFIG_SCSI_UFS_MEDIATEK_DBG=m
CONFIG_KEYBOARD_MTK_KPD=m
CONFIG_KEYBOARD_MTK_PMIC=m
CONFIG_KPD_VOLUME_KEY_SWAP=y
CONFIG_SERIAL_8250_MT6577=m
CONFIG_I2C_MT65XX=m
CONFIG_I2C_HID=m
CONFIG_I2C_CHARDEV=m
CONFIG_MTK_AAL_SUPPORT=y
CONFIG_SPI_MT65XX=m
CONFIG_SPMI_MTK_PMIF=m
CONFIG_HIDRAW=y
CONFIG_HID_MULTITOUCH=y
CONFIG_HID_BATTERY_STRENGTH=y
CONFIG_HID_TOUCHSCREEN_FTS=m
CONFIG_HID_SANIDINE=m
CONFIG_HID_TOUCH_METRICS=m
CONFIG_STYLUS_BATTERY_ALGO=m
CONFIG_TOUCHSCREEN_FTS_DIRECTORY="focaltech_touch"
CONFIG_TOUCHSCREEN_FTS=m
CONFIG_TOUCHSCREEN_NT36XXX=m
CONFIG_TOUCHSCREEN_ILI9882=m
CONFIG_I2C_HID_ILITEK=m
CONFIG_I2C_HID_OF_NVT_TS=m
CONFIG_I2C_HID_NO_USE_PM=y
CONFIG_TP_TO_LCD_ESD_CHECK=y
# CONFIG_PINCTRL_MT2712 is not set
# CONFIG_PINCTRL_MT6797 is not set
# CONFIG_PINCTRL_MT6779 is not set
# CONFIG_PINCTRL_MT6885 is not set
# CONFIG_PINCTRL_MT6983 is not set
# CONFIG_PINCTRL_MT7622 is not set
# CONFIG_PINCTRL_MT8167 is not set
# CONFIG_PINCTRL_MT8173 is not set
# CONFIG_PINCTRL_MT8183 is not set
# CONFIG_PINCTRL_MT8192 is not set
CONFIG_PINCTRL_MT8188=m
# CONFIG_PINCTRL_MT8516 is not set
# CONFIG_PINCTRL_MT6397 is not set
CONFIG_GPIO_SYSFS=y
CONFIG_HAVE_MTK_MC=y
CONFIG_MTK_DRAMC=m
CONFIG_MTK_EMI=m
CONFIG_REBOOT_MODE=m
CONFIG_SYSCON_REBOOT_MODE=m
CONFIG_BATTERY_MT6359P=m
CONFIG_MTK_CHARGER_TYPE_DETECT=m
CONFIG_MTK_CHARGER=m
CONFIG_MFD_RT9467=m
CONFIG_RT9467_ADC=m
CONFIG_CHARGER_RT9467=m
CONFIG_MTK_PERF_TRACKER=y
CONFIG_MTK_PUMP_EXPRESS_40_SUPPORT=m
CONFIG_VIRTUAL_SENSOR_THERMAL=m
CONFIG_THERMAL_SHUTDOWN_LAST_KMESG=y
CONFIG_MTK_THERMAL=m
CONFIG_MTK_SOC_THERMAL_LVTS=m
CONFIG_MTK_PMIC_THERMAL=m
CONFIG_GENERIC_ADC_THERMAL=m
CONFIG_SYSRST_COOLING=m
CONFIG_MEDIATEK_WATCHDOG=m
CONFIG_MFD_MT6360=m
CONFIG_MFD_MT6397=m
CONFIG_MTK_SYSTRACKER_V2=m
CONFIG_REGULATOR_MT6315=m
CONFIG_REGULATOR_MT6359=m
CONFIG_REGULATOR_MT6360=m
CONFIG_REGULATOR_MTK_DVFSRC=m
CONFIG_REGULATOR_MTK_VMM=m
CONFIG_MTK_VMM_SPM=m
CONFIG_MTK_SECURITY_SW_SUPPORT=m
CONFIG_MTK_GPU_SUPPORT=m
CONFIG_MTK_GPU_VERSION="mali valhall r25p0 mt8188"
CONFIG_MTK_GPU_COMMON_DVFS_SUPPORT=y
CONFIG_SND_SOC_MT8188=m
CONFIG_SND_SOC_MT8188_SUNSTONE=m
CONFIG_USB_MTU3=m
CONFIG_NEW_LEDS=y
CONFIG_LEDS_CLASS=y
CONFIG_LEDS_MTK=m
CONFIG_LEDS_MTK_PWM=m
CONFIG_MTK_BACKLIGHT_THERMAL=m
CONFIG_LEDS_REGULATOR_VIBRATOR=m
CONFIG_LEDS_MT6360=m
CONFIG_MTK_FLASHLIGHT=m
CONFIG_MTK_V4L2_FLASHLIGHT=m
CONFIG_V4L2_FLASH_LED_CLASS=m
CONFIG_RTC_DRV_MT6397=m
CONFIG_MTK_UART_APDMA=m
CONFIG_ION=y
CONFIG_ION_SYSTEM_HEAP=y
CONFIG_MTK_ION_MM_HEAP=m
CONFIG_MTK_ION_SEC_HEAP=m
CONFIG_MTK_IOMMU=m
CONFIG_MTK_IOMMU_MT8XXX=y
CONFIG_MTK_DEVAPC=m
CONFIG_MTK_DVFSRC=m
CONFIG_MTK_PMIC_WRAP=m
CONFIG_MTK_SCHEDULER=m
CONFIG_MTK_EAS=y
CONFIG_MTK_NEWIDLE_BALANCE=y
CONFIG_MTK_SCPSYS=m
CONFIG_MTK_IPI=m
CONFIG_MTK_MBOX=m
CONFIG_MTK_SVS=m
CONFIG_RPMSG_MTK=m
CONFIG_HW_RANDOM_SECURE=m
CONFIG_MTK_DVFSRC_DEVFREQ=m
CONFIG_MEDIATEK_MT635X_AUXADC=m
CONFIG_MEDIATEK_MT6360_AUXADC=m
CONFIG_MEDIATEK_MT6577_AUXADC=m
CONFIG_STATIC_USERMODEHELPER_PATH="/system_ext/bin/crashreport"
CONFIG_ARM_MEDIATEK_CPUFREQ_HW=m
CONFIG_CPU_FREQ_DEFAULT_GOV_PERFORMANCE=y
CONFIG_MTK_CACHE_PARITY_CHECK=m
CONFIG_PWM=y
CONFIG_PWM_MTK_DISP=m
CONFIG_RESET_CONTROLLER=y
CONFIG_RESET_TI_SYSCON=m
CONFIG_PHY_MTK_TPHY=m
CONFIG_MTK_DEVINFO=m
CONFIG_MT6359_EFUSE=m
CONFIG_INTERCONNECT_MTK=m
CONFIG_INTERCONNECT_MTK_EMI=m
CONFIG_INTERCONNECT_MTK_MMQOS_MT8188=m
CONFIG_MTK_QOS_FRAMEWORK=m
CONFIG_MTK_PRINTK_UART_CONSOLE=y
CONFIG_MTK_PRINTK=m
CONFIG_MTK_CAMERA_ISP_PLATFORM="mt6893"
CONFIG_MTK_V4L2_IMGSENSOR=m
CONFIG_MTK_CCU_RPROC=m
CONFIG_VIDEO_DEV=y
CONFIG_V4L2_FWNODE=m
CONFIG_MTK_CCD_REMOTEPROC=m
CONFIG_VIDEO_MTK_ISP_CAMSYS=m
CONFIG_VIDEO_MTK_AIE=m
CONFIG_MTK_CAM_TIMESYNC=m
CONFIG_MTK_CAMERA_MEM_SUPPORT=m
CONFIG_VIDEO_MTK_ISP_HCP=m
CONFIG_VIDEO_MTK_ISP_IMGSYS=m
CONFIG_VIDEO_MTK_ISP_IPESYS=m
CONFIG_MTK_CAMERA_ISP_SUPPORT=y
CONFIG_MTK_CAMERA_MFB_ISP6S=m
CONFIG_MTK_CAMERA_ISP_WPE_SUPPORT=m
# CONFIG_MTK_CAMERA_DPE_ISP6S is not set
# CONFIG_MTK_CAMERA_RSC_ISP6S is not set
CONFIG_MTK_CAMERA_DIP_ISP6S=m
CONFIG_MTK_CAMERA_DUAL_DIP_ISP6S=m
CONFIG_CUSTOM_KERNEL_IMGSENSOR="hi846_rear_mipi_raw hi846_front_mipi_raw sc800_rear_suntxd_mipi_raw sc800_front_suntxd_mipi_raw"
# CONFIG_MTK_IMGSENSOR is not set
CONFIG_MTK_IMGSENSOR_PLATFORM_SUPPORT=y
CONFIG_MTK_IMGSENSOR_MT6893=y
CONFIG_MTK_VOW_DSP_VERSION="ver02"
CONFIG_MTK_CCU=m
CONFIG_MTK_LENS=m
CONFIG_MTK_LOW_POWER_MODULE=m
CONFIG_MTK_LPM_MT8188=m
CONFIG_MTK_SWPM_PERF_ARMV8_PMU=m
CONFIG_MTK_MMDVFS=m
CONFIG_ZSMALLOC=m
CONFIG_ZRAM=m
CONFIG_MTK_TINYSYS_MCUPM_SUPPORT=m
CONFIG_MTK_SENSOR_SUPPORT=m
CONFIG_MTK_SENSOR_ARCHITECTURE="1.0"
CONFIG_MTK_SLBC_MMSRAM=m
CONFIG_CUSTOM_KERNEL_ACCELEROMETER=y
CONFIG_MTK_MC34XX=y
CONFIG_MTK_STK8XXX=y
CONFIG_CUSTOM_KERNEL_ALSPS=y
# CONFIG_MTK_LTR559=y is not set
CONFIG_MTK_LTR578=y
CONFIG_MTK_HWMON=y
CONFIG_MTK_CM_MGR=m
CONFIG_MTK_CM_MGR_MT8188=m
CONFIG_MMC_MTK=m
CONFIG_MMC_EXPOSE_START_HOST_API=y
CONFIG_PWRSEQ_SIMPLE=m
CONFIG_MMC_MTK_SDIO=m
CONFIG_MMC_CQHCI=m
CONFIG_MMC_REALTIME_LIFETIME=y
CONFIG_MTK_PERFORMANCE_MODULE=m
CONFIG_MTK_PERFMGR_TOUCH_BOOST=m
CONFIG_MTK_ATF_LOGGER=m
CONFIG_MTK_ICE_DEBUG=m
CONFIG_VIDEO_MEDIATEK_VCODEC=m
CONFIG_VIDEO_MEDIATEK_VCU=m
CONFIG_VIDEO_MEDIATEK_JPEG=m
CONFIG_VIDEO_MEDIATEK_VCODEC_V2=y
CONFIG_DRM_PANEL_BIAS_SUPPORT=m
CONFIG_DRM_PANEL_BACKLIGHT_SUPPORT=m
CONFIG_DRM_PANEL_FT8205_WUXGA_DSI_VDO=m
CONFIG_DRM_PANEL_NT36523B_WUXGA_DSI_VDO=m
CONFIG_DRM_PANEL_ILI9882T_WUXGA_DSI_VDO=m
CONFIG_DRM_MEDIATEK=m
CONFIG_DRM_MEDIATEK_V2=y
CONFIG_MTK_WFD_OVER_VDO1=y
CONFIG_MTK_SEC_VIDEO_PATH_SUPPORT=y
CONFIG_BACKLIGHT_LCD_SUPPORT=y
CONFIG_LCD_CLASS_DEVICE=m
CONFIG_LOGO=y
CONFIG_IDME=m
# CONFIG_AMAZON_METRICS_LOG is not set
CONFIG_AMAZON_MINERVA_METRICS_LOG=m
CONFIG_MTK_SOCINFO=m
CONFIG_ARM_DSU_PMU=m
CONFIG_MTK_CAM_CAL=y
CONFIG_MTK_V4L2_LENS=m
CONFIG_MTK_DBGTOP=m
CONFIG_MTK_JPEG=m
CONFIG_MTK_SDA=y
CONFIG_MTK_IRQ_DBG=m
CONFIG_COMMON_CLK_MEDIATEK_DISABLE_UNUSED=m
CONFIG_MTK_SCPSYS_PM_DOMAINS_DISABLE_UNUSED=m
CONFIG_COMMON_CLK_MEDIATEK=m
CONFIG_COMMON_CLK_MT8188=m
CONFIG_COMMON_CLK_MT8188_AUDSYS=m
CONFIG_COMMON_CLK_MT8188_AUDSYS_SRC=m
CONFIG_COMMON_CLK_MT8188_CAMSYS=m
CONFIG_COMMON_CLK_MT8188_IMGSYS=m
CONFIG_COMMON_CLK_MT8188_IMP_IIC_WRAP=m
CONFIG_COMMON_CLK_MT8188_IPESYS=m
CONFIG_COMMON_CLK_MT8188_VDECSYS=m
CONFIG_COMMON_CLK_MT8188_VDOSYS0=m
CONFIG_COMMON_CLK_MT8188_VDOSYS1=m
CONFIG_COMMON_CLK_MT8188_VENCSYS=m
CONFIG_COMMON_CLK_MT8188_VPPSYS0=m
CONFIG_COMMON_CLK_MT8188_VPPSYS1=m
CONFIG_COMMON_CLK_MT8188_WPESYS=m
CONFIG_COMMON_CLK_MT8188_CCUSYS=m
CONFIG_COMMON_CLK_MT8188_MFGCFG=m
CONFIG_COMMON_CLK_MTK_FREQ_HOPPING=m
CONFIG_COMMON_CLK_MTK_FREQ_HOPPING_MCUPM=y
CONFIG_MTK_SCPSYS_PM_DOMAINS=m
# CONFIG_ARM64_BTI is not set
# CONFIG_BT_HCIBTSDIO is not set
CONFIG_BT=y
CONFIG_MTK_COMBO_WIFI=y
CONFIG_EXTCON_POGO_PIN=m
CONFIG_EXTCON_USB_GPIO=y
CONFIG_CFG80211=m
CONFIG_NL80211_TESTMODE=y
CONFIG_CFG80211_DEVELOPER_WARNINGS=y
CONFIG_MTK_TINYSYS_SSPM_SUPPORT=m
CONFIG_MTK_TINYSYS_SSPM_V2=y
CONFIG_USB_CONFIGFS_F_MTP=m
CONFIG_USB_CONFIGFS_F_UVC=y
CONFIG_MTK_STC=m
CONFIG_MTK_MET=m
CONFIG_MTK_MET_RESERVED_MEM_BY_TINYSYS=y
CONFIG_MTK_MET_SSPM_LEGACY_IPI=y
CONFIG_MTK_DFD_INTERNAL_DUMP=m
CONFIG_INPUT_HALL_BU520=m
CONFIG_SND_SOC_DBMDX=m
CONFIG_SND_SOC_DBMDX_SND_CAPTURE=y
CONFIG_SND_SOC_DBMDX_USE_ANALOG_MICS=y
CONFIG_SND_SOC_DBMDX_ALEXA_WWE_SUPPORT=y
CONFIG_AMAZON=y
CONFIG_AMAZON_DSP_FRAMEWORK=y
CONFIG_AMAZON_DSP_FRAMEWORK_CHAR_LEN=2
CONFIG_SWITCH=m
CONFIG_FUSB251=m
CONFIG_MAX20342=m
CONFIG_AMZN_LD=m
CONFIG_PUBADC_MANAGE=m
CONFIG_MTK_BOOT=m
CONFIG_SECURITY_DMESG_RESTRICT=y
# CONFIG_VHOST_MENU is not set
# CONFIG_DEBUG_FS is not set
# CONFIG_PAGE_PINNER is not set
# CONFIG_PAGE_OWNER is not set
# CONFIG_SLUB_DEBUG is not set
# CONFIG_DEBUG_INFO is not set
# CONFIG_BUG_ON_DATA_CORRUPTION is not set
# CONFIG_COMPAT_VDSO is not set
# CONFIG_HIST_TRIGGERS is not set
CONFIG_SYN_COOKIES=y
CONFIG_DYNAMIC_DEBUG=y
CONFIG_TRACER_SNAPSHOT=y
CONFIG_TRACER_MAX_TRACE=y
CONFIG_POWER_SUPPLY_HWMON=y
CONFIG_HWMON=y
CONFIG_THERMAL_HWMON=y
CONFIG_CONNECTOR=y
CONFIG_PROC_EVENTS=y
CONFIG_LOG_BUF_SHIFT=19
CONFIG_HID_ICADE=y
CONFIG_HID_LENOVO=y
CONFIG_HID_GFRM=y
CONFIG_HID_TIVO=y
CONFIG_HID_ASUS=y
CONFIG_HID_LOGITECH=y
CONFIG_HID_WIIMOTE=y
CONFIG_HID_APPLE=y
CONFIG_HID_SONY=y
CONFIG_HID_ELECOM=y
CONFIG_HID_TOPSEED=y
CONFIG_HID_LOGITECH_HIDPP=y
CONFIG_HID_MICROSOFT=y
CONFIG_HID_NINTENDO=y
CONFIG_HID_MAGICMOUSE=y
# CONFIG_HID_PLAYSTATION is not set
CONFIG_USER_BUILD=y
CONFIG_AMAZON_INPUT_KEYCOMBO=m
CONFIG_INPUT_KEYCOMBO=m
CONFIG_AMAZON_POWEROFF_LOG=y
CONFIG_AMAZON_SIGN_OF_LIFE=m
CONFIG_MTK_MET_MEM_ALLOC=y
# CONFIG_KVM is not set
CONFIG_MTK_USE_AGING_ZCV=y
CONFIG_MDUMP=y
CONFIG_DEM_EN=y
```

## drivers/hid/ILITEK_HID_over_I2c/Kconfig
```kconfig
#
# HID driver configuration
#
config I2C_HID_ILITEK
	tristate "TP ilitek i2c hid enable"
	depends on I2C_HID && STYLUS_BATTERY_ALGO
	default n
	help
	  say Y to enable driver for Touchpanel using ilitek i2c hid.
	  If unsure, say N.
```

## drivers/hid/hid_touch_metrics/Kconfig
```kconfig
#
# hid touch metrics configuration
#
config HID_TOUCH_METRICS
	tristate "hid touch metrics enable"
	default n
	depends on AMAZON_MINERVA_METRICS_LOG
	help
	  say Y to enable hid touch metrics.
	  If unsure, say N.
	  When the touch is not working or the battery level of the indicator pen changes abnormally, use the metrics log for printing.
```

## drivers/hid/i2c_hid_of_nvt_ts/Kconfig
```kconfig
# SPDX-License-Identifier: GPL-2.0-only
#
# Driver locate under i2c-hid/
#
# To include this Kconfig, add
# ...
# source drivers/hid/i2c-hid/i2c_hid_of_nvt_ts/Kconfig
# ...
# in i2c-hid/Kconfig
#
# and add CONFIG_I2C_HID_OF_NVT_TS=y in your defconfig

config I2C_HID_OF_NVT_TS
	tristate "Driver for Novatek hid-i2c based devices on OF systems"
	default n
	depends on I2C_HID && INPUT && OF && STYLUS_BATTERY_ALGO
	help
	  Say Y here if you use NVT touchscreen IC which supports i2c-hid
	  protocol. This driver supports Open Firmware (Device Tree)-based
	  systems.

	  If unsure, say N.

config I2C_HID_OF_NVT_TS_SELFTEST
	tristate "Driver for Novatek selftest"
	default n
	depends on I2C_HID_OF_NVT_TS
	help
	  Say Y to enable driver using csv file for selftest.

	  If unsure, say N.
```

## drivers/hid/stylus/Kconfig
```kconfig
#
# stylus batterry algo configuration
#
config STYLUS_BATTERY_ALGO
	tristate "stylus battery algo enable"
	default n
	help
	  say Y to enable stylus battery algo.
	  If unsure, say N.
	  stylus driver depends on touch drivers to parse stylus informations in HID packet.
```

## drivers/input/touchscreen/ILITEK_V3/Kconfig
```kconfig
#
# Ilitek ILI9882 touchscreen driver configuration
#

config TOUCHSCREEN_ILI9882
	tristate "ILI9882 ILITEK"
	default n
	help
	  Say Y here if you have ILI9882 touch panel.

	  If unsure, say N.

	  To compile this driver as a module, choose M here: the
	  module will be called.
```

## drivers/input/touchscreen/NT36523/Kconfig
```kconfig
#
# Novatek NT36xxx touchscreen driver configuration
#
config TOUCHSCREEN_NT36XXX
	tristate "Novatek NT36xxx"
	default n
	help
	  Say Y here if you have a Novatek NT36523 touchscreen connected
	  to your system.

	  If unsure, say N.
```

## drivers/misc/mediatek/asrc/Kconfig
```kconfig
# SPDX-License-Identifier: GPL-2.0
config AUDIO_ASRC_COMMON
	tristate

config AUDIO_ASRC_MT8188
	tristate "Audio ASRC support for Mediatek MT8188 chip"
	select AUDIO_ASRC_COMMON
	help
	  This adds Audio ASRC driver support for Mediatek MT8188 chip
```

## drivers/misc/mediatek/leakage_table/Kconfig
```kconfig
config MTK_STATIC_POWER
	tristate "MediaTek GPU Voltage Scaling Module"
	help
	  This driver provides leakage efuse dump for
	  multiple domain. Those leakage (mw) are
	  calculated by Efuse value and ATE Voltage.
	  Select "y" if you want to enable this features.
	  Select "n" if unsure.

config MT8188_STATIC_POWER
	tristate "MediaTek MT8188 Voltage Scaling Module"
	help
	  This driver provides leakage efuse dump for
	  multiple domain. Those leakage (mw) are
	  calculated by Efuse value and ATE Voltage.
	  Select "y" if you want to enable this features.
	  Select "n" if unsure.
```

## drivers/misc/mediatek/performance/Kconfig
```kconfig
config MTK_FPSGO_V3
	tristate "Support FPSGO_V3 framework"
	depends on MTK_GPU_SUPPORT && MTK_DVFSRC
	help
	  Support FPSGO_V3 framework for most FPS performance and
	  low power balance. As a perquisite to ensure FPS performance,
	  FPSGO_V3 persuades lowest power consumption for better DoU
	  endurance and gaming experience.
	  FPSGO_V3 include AI performance and low power.
	  If you are not sure about this, set n.

config MTK_PERFORMANCE_MODULE
	tristate "Mediatek Performance Module"
	help
	  For MediaTek performance modules, such as FPSGO and EARA-QoS
	  Select "y" if you want to enable power throttling feature
	  Select "n" if unsure.

config MTK_FPS_COOLER
	tristate "Mediatek FPS Cooler"
	help
	  Support FPS Cooler intergface. FPS Cooler will adjustment
	  target fps by thermal.
	  If you are not sure about this, set n.

config MTK_LOAD_TRACKER
	tristate "CPU Loading Tracking Service"
	depends on CPU_FREQ
	default n
	help
	  MTK_LOAD_TRACKER is the kernel config of CPU Loading Tracking
	  Service designed by MTK, which is a service to get CPU Loading
	  information. User can register callback and config polling
	  duration to get CPU loading.

config MTK_PERFMGR_TOUCH_BOOST
	tristate "touch boost in performance manager"
	depends on MTK_PERFORMANCE_MODULE
	help
	  MTK_PERFMGR_TOUCH_BOOST is the kernel config of touch boost
	  feature designed by MTK, which is a performance improving
	  feature for user experience. When the device receives touch
	  event, it will raise system resources(CPU frequency / CPU cores)
	  for better user experience.
```
